## mcu/esp-idf/example/main/Kconfig.projbuild
```kconfig
menu "Reticulum MCU example"

    choice RETICULUM_MCU_TRANSPORT
        prompt "Serial port"
        default RETICULUM_MCU_TRANSPORT_UART
        help
            The serial port. In serial mode (the default) it carries the HDLC framing
            (Reticulum SerialInterface). In Wi-Fi mode the HDLC stream runs on TCP and
            this port carries the provisioning console and status text instead.
            With UART0 the console must not use UART0: sdkconfig.defaults moves it
            elsewhere or disables it, because log text would corrupt the stream.

        config RETICULUM_MCU_TRANSPORT_UART
            bool "UART (UART0 by default, the port behind the board's USB-UART bridge)"

        config RETICULUM_MCU_TRANSPORT_USB_SERIAL_JTAG
            bool "Built-in USB Serial/JTAG (chips that have it, such as ESP32-S3)"
            depends on SOC_USB_SERIAL_JTAG_SUPPORTED
    endchoice

    config RETICULUM_MCU_UART_NUM
        int "UART number"
        depends on RETICULUM_MCU_TRANSPORT_UART
        range 0 2
        default 0

    config RETICULUM_MCU_UART_BAUD
        int "UART baud rate"
        depends on RETICULUM_MCU_TRANSPORT_UART
        range 1200 3000000
        default 115200
        help
            Must equal the speed of the SerialInterface on the host side.

    config RETICULUM_MCU_UART_TX_GPIO
        int "UART TX GPIO (-1 keeps the default pin of the UART)"
        depends on RETICULUM_MCU_TRANSPORT_UART
        default -1

    config RETICULUM_MCU_UART_RX_GPIO
        int "UART RX GPIO (-1 keeps the default pin of the UART)"
        depends on RETICULUM_MCU_TRANSPORT_UART
        default -1

    config RETICULUM_MCU_TASK_STACK
        int "Stack size of the Reticulum task in bytes"
        range 12288 65536
        default 16384
        help
            The protocol core and the portable crypto need at least 12 KB.

    config RETICULUM_MCU_ANNOUNCE_SECONDS
        int "Announce interval in seconds"
        range 5 86400
        default 600

    config RETICULUM_MCU_BOARD
        string "Board name reported by /info"
        default "esp32s3" if IDF_TARGET_ESP32S3
        default "esp32"

    config RETICULUM_MCU_PROVISION_WINDOW_MS
        int "Provisioning window after boot in milliseconds (0 = none)"
        range 0 60000
        default 2000
        help
            During this window after every boot the line "rnc-config" on the serial
            port, or the BOOT button held for 300 ms, starts the provisioning console
            (mcu/README.txt). In serial mode this much start-up time passes before the
            node starts. The console also starts, without waiting, when Wi-Fi mode is
            selected and the stored settings are unusable.

    config RETICULUM_MCU_PROVISION_BOOT_GPIO
        int "BOOT button GPIO for the provisioning window (-1 = no button)"
        range -1 48
        default 0
        help
            GPIO0 is the BOOT button of the ESP32 and ESP32-S3 boards. It is read only
            after the chip started: holding it while resetting selects the ROM
            download mode instead.

    choice RETICULUM_MCU_LORA_BOARD
        prompt "LoRa board (the radio's pin map and chip)"
        default RETICULUM_MCU_LORA_BOARD_NONE
        help
            Selects the pin map and the radio chip of the board for the optional LoRa
            interface (mcu/radio/README.txt). This is hardware, not a radio setting: the
            frequency, bandwidth, spreading factor, coding rate and power are NEVER set
            here. They are provisioned at runtime (lora.* keys of the console and of
            mcu/tools/wifi-config.sh) and the radio stays off until all of them are
            given. The operator is responsible for a legal frequency, power and duty
            cycle where the board is used.

        config RETICULUM_MCU_LORA_BOARD_NONE
            bool "No LoRa radio in this image"

        config RETICULUM_MCU_LORA_BOARD_HELTEC_V3
            bool "Heltec WiFi LoRa 32 V3 (ESP32-S3, SX1262)"
            depends on IDF_TARGET_ESP32S3

        config RETICULUM_MCU_LORA_BOARD_HELTEC_V2
            bool "Heltec WiFi LoRa 32 V2 (ESP32, SX1276)"
            depends on IDF_TARGET_ESP32

        config RETICULUM_MCU_LORA_BOARD_TBEAM
            bool "LilyGo T-Beam v1.0/v1.1 (ESP32, SX1276, AXP192)"
            depends on IDF_TARGET_ESP32

        config RETICULUM_MCU_LORA_BOARD_T3S3
            bool "LilyGo T3-S3 (ESP32-S3, SX1262)"
            depends on IDF_TARGET_ESP32S3
    endchoice

    config RETICULUM_MCU_LORA_BOARD_ID
        string
        default "heltec_wifi_lora_32_V3" if RETICULUM_MCU_LORA_BOARD_HELTEC_V3
        default "heltec_wifi_lora_32_V2" if RETICULUM_MCU_LORA_BOARD_HELTEC_V2
        default "ttgo_t_beam" if RETICULUM_MCU_LORA_BOARD_TBEAM
        default "lilygo_t3_s3" if RETICULUM_MCU_LORA_BOARD_T3S3
        default ""

    menu "Developer defaults for Wi-Fi (NOT FOR RELEASE)"

        config RETICULUM_MCU_DEV_WIFI_DEFAULTS
            bool "Compile Wi-Fi credentials into the firmware (developer builds only)"
            default n
            help
                DO NOT enable this for firmware you publish or give to anyone: the
                SSID, the password and the server address would be readable in the
                image and in the ELF file, by anyone who gets a copy. Release images
                are built without it and are provisioned at runtime
                (mcu/tools/wifi-config.sh or the serial console).
                When enabled, the values below apply only while the settings partition
                holds no mode; anything provisioned at runtime wins.
                mcu/build-esp-idf.sh marks such a build in build-info.txt, and the
                release packaging refuses it.

        config RETICULUM_MCU_DEV_WIFI_SSID
            string "Wi-Fi SSID"
            depends on RETICULUM_MCU_DEV_WIFI_DEFAULTS
            default ""

        config RETICULUM_MCU_DEV_WIFI_PASSWORD
            string "Wi-Fi password (empty = open network)"
            depends on RETICULUM_MCU_DEV_WIFI_DEFAULTS
            default ""

        config RETICULUM_MCU_DEV_SERVER_HOST
            string "Server host (a TCPServerInterface)"
            depends on RETICULUM_MCU_DEV_WIFI_DEFAULTS
            default ""

        config RETICULUM_MCU_DEV_SERVER_PORT
            int "Server port"
            depends on RETICULUM_MCU_DEV_WIFI_DEFAULTS
            range 1 65535
            default 4242

    endmenu

endmenu
```
